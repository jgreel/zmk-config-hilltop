## boards/shields/hilltop/Kconfig.shield
```kconfig
# No whitespace after the comma or in the keyboard name!
config SHIELD_HILLTOP_DONGLE
    def_bool $(shields_list_contains,hilltop_dongle)
    
config SHIELD_HILLTOP_LEFT
    def_bool $(shields_list_contains,hilltop_left)

config SHIELD_HILLTOP_RIGHT
    def_bool $(shields_list_contains,hilltop_right)
```

## config/boards/shields/hilltop/Kconfig.defconfig
```kconfig
if SHIELD_HILLTOP_LEFT

config ZMK_KEYBOARD_NAME
    default "Hilltop"

config ZMK_SPLIT_ROLE_CENTRAL
    default y

endif

if SHIELD_HILLTOP_LEFT || SHIELD_HILLTOP_RIGHT

config ZMK_SPLIT
    default y

endif
```

## config/west.yml
```yaml
manifest:
  defaults:
    revision: v0.3
  remotes:
    - name: zmkfirmware
      url-base: https://github.com/zmkfirmware
    - name: jgreel
      url-base: https://github.com/jgreel
    - name: urob
      url-base: https://github.com/urob
    - name: petejohanson
      url-base: https://github.com/petejohanson/
    - name: AYM1607
      url-base: https://github.com/AYM1607/
    - name: halfdane
      url-base: https://github.com/halfdane/
    # Additional modules containing boards/shields/custom code can be listed here as well
  projects:
    - name: zmk
      remote: zmkfirmware
      import: app/west.yml
    # - name: cirque-input-module
    #   remote: petejohanson
    #   revision: main
    - name: zmk-driver-azoteq-iqs5xx
      remote: AYM1607
      revision: main
    - name: zmk-input-gestures
      remote: halfdane
      revision: main
    # Add these if you want to use absolute mode:
    #- name: zmk-input-processors
    #  remote: halfdane
    #  revision: main
    #- name: cirque-input-module
    #  remote: halfdane
    #  revision: absolute_mode
  self:
    path: config
```
