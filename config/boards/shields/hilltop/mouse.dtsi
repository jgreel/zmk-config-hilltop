#include <dt-bindings/zmk/mouse.h>

&mmv {
    acceleration-exponent = <1>;      // 1
    time-to-max-speed-ms = <200>;    // 40
    delay-ms = <0>;                   // 0
};

&msc {
    time-to-max-speed-ms = <1000>;    // 40
    delay-ms = <0>;                   // 10
};

#define U_MOUSE_MOVE_MAX 750      // 600
#define U_MOUSE_SCROLL_MAX 250      // 10

#undef MOVE_UP
#undef MOVE_DOWN
#undef MOVE_LEFT
#undef MOVE_RIGHT
#define MOVE_UP MOVE_Y(-U_MOUSE_MOVE_MAX)
#define MOVE_DOWN MOVE_Y(U_MOUSE_MOVE_MAX)
#define MOVE_LEFT MOVE_X(-U_MOUSE_MOVE_MAX)
#define MOVE_RIGHT MOVE_X(U_MOUSE_MOVE_MAX)

#undef SCROLL_UP
#undef SCROLL_DOWN
#undef SCROLL_LEFT
#undef SCROLL_RIGHT
#define SCROLL_UP SCRL_Y(U_MOUSE_SCROLL_MAX)
#define SCROLL_DOWN SCRL_Y(-U_MOUSE_SCROLL_MAX)
#define SCROLL_LEFT SCRL_X(-U_MOUSE_SCROLL_MAX)
#define SCROLL_RIGHT SCRL_X(U_MOUSE_SCROLL_MAX)